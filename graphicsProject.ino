#include <ButtonClass.h>
#include "U8glib.h"
#include <RtcDS3231.h>
#include <Wire.h>

RtcDS3231<TwoWire> rtcModule(Wire);

// Create new SSD1306 I2C display with 128x64 resolution
U8GLIB_SSD1306_128X64 oled(U8G_I2C_OPT_NONE);
const int logo_width = 128;
const int logo_height = 64;

static unsigned char logo_bits [] U8G_PROGMEM = {
  0x00, 0x00, 0x00, 0x00, 0x00, 0x00, 0x00, 0x00, 0x00, 0x00, 0x00, 0x00,
  0x00, 0x00, 0x00, 0x00, 0x00, 0x00, 0x00, 0x00, 0x00, 0x00, 0x00, 0x00,
  0x00, 0x00, 0x00, 0x00, 0x00, 0x00, 0x00, 0x00, 0x00, 0x00, 0x00, 0x00,
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  0x00, 0x00, 0x00, 0x00,
};

ButtonClass button2(3);
ButtonClass button1(2);
ButtonClass button3(4);
const byte maxLength = 80;
unsigned int frameNow = 0;
byte rotation;
byte xPos[maxLength];
byte yPos[maxLength];
byte score;
int active;
byte fruitX;
byte fruitY;
bool startUp = true;
bool playSnake = false;

void setup() {
  // put your setup code here, to run once:
  gameSetup();
}
void startUpImage() {
  if (millis() < 3000)
  {
    oled.drawXBMP(0, 0, logo_width, logo_height, logo_bits);
  } else {
    startUp = false;
  }
}
void loop(void) {

  oled.firstPage();
  do {
    draw();
    buttonListeners();
  } while (oled.nextPage());
}

void buttonListeners() {
  if (button1.button_click(2))
  {
    changeRotation(false);
  } else if (button2.button_click(3))
  {
    changeRotation(true);
  } else if (button3.button_click(4))
  {
    playSnake = !playSnake;
    gameSetup();
  }
}

void updateTimeTempDisp()
{
  RtcDateTime now = rtcModule.GetDateTime();
  RtcTemperature t1 = rtcModule.GetTemperature();
  float temp = t1.AsFloatDegC();
  byte hour = now.Hour();
  byte minute = now.Minute();
  byte date[] = {now.Month(),now.Day(),now.DayOfWeek()};
  int year = now.Year();
  displayTime(hour,minute);
  displayDate(date,temp,year);
  
}

void displayTime(byte hour, byte minute)
{
  oled.setFont(u8g_font_helvB24);
  char timeString[5];
  sprintf(timeString, "%02u:%02u", hour, minute);
  oled.setPrintPos(20, 30);
  oled.print(timeString);
}

void displayDate(byte date[],float temp,int year)
{
  char dateString[14];
  String day = getDayOfWeek(date[2]);
  sprintf(dateString,"%02u--%02u--%04u", date[1], date[0],year);
  oled.setFont(u8g_font_helvR12);
  oled.setPrintPos(0, 58);
  oled.print(dateString);
  //oled.setPrintPos(64, 58);
  //oled.print(day);
}


String getDayOfWeek(int value)
{
  String day;
  switch (value)
  {
    case 1:
      day = "Monday";
      break;

    case 2:
      day = "Tuesday";
      break;

    case 3:
      day = "Wednesday";
      break;

    case 4:
      day = "Thursday";
      break;

    case 5:
      day = "Friday";
      break;

    case 6:
      day = "Saturday";
      break;

    case 0:
      day = "Sunday";
      break;

  }
  return day;
}


void gameSetup() {
  xPos[0] = 64;
  yPos[0] = 40;
  xPos[1] = 65;
  yPos[1] = 41;
  score = 0;
  spawnFruit();
  active = 1;
  rotation = 0;
}

void drawSnake() {
  byte index;
  for (byte a = 0; a <= score; a++)
  {
    index = (active + 2 * maxLength - (2 * a)) % maxLength;
    if (a > maxLength / 2) {
      break;
    }
    for (byte i = 0; i < 4; i++)
    {
      for (byte j = 0; j < 4; j++)
      {
        if (!(i % 3 == 0 && j % 3 == 0))
        {
          oled.drawPixel(xPos[index] + i - 2, yPos[index] + j - 1);
        }
      }
    }
  }
}

bool collision() {
  bool returnBool = false;
  if (xPos[active] < 1 || xPos[active] > 125)
  {
    returnBool = true;
  } else if (yPos[active] < 1 || yPos[active] > 63)
  {
    returnBool = true;
  }

  byte index;

  for (byte i = 0; i < 2 * score; i++)
  {
    index = (active + maxLength - i - 1) % maxLength;
    if (xPos[active] == xPos[index] && yPos[active] == yPos[index] && index != active)
    {
      returnBool = true;
      break;
    }
  }

  return returnBool;
}

void snakeDraw() {
  byte index;
  for (byte a = 0; a <= score; a++)
  {
    index = (active + 2 * maxLength - (2 * a)) % maxLength;
    if (a > maxLength / 2) {
      break;
    }
    oled.drawPixel(xPos[index] - 1, yPos[index]);
    oled.drawPixel(xPos[index], yPos[index]);
    oled.drawPixel(xPos[index] - 2, yPos[index] - 1);
    oled.drawPixel(xPos[index] - 1, yPos[index] - 1);
    oled.drawPixel(xPos[index], yPos[index] - 1);
    oled.drawPixel(xPos[index] + 1, yPos[index] - 1);
    oled.drawPixel(xPos[index] - 2, yPos[index] - 2);
    oled.drawPixel(xPos[index] - 1, yPos[index] - 2);
    oled.drawPixel(xPos[index], yPos[index] - 2);
    oled.drawPixel(xPos[index] + 1, yPos[index] - 2);
    oled.drawPixel(xPos[index] - 1, yPos[index] - 3);
    oled.drawPixel(xPos[index], yPos[index] - 3);
  }

}

void activeNext() {
  active = (active + 1) % maxLength;
}

void changeRotation(bool leftOrRight) {
  if (leftOrRight)
  {
    switch (rotation)
    {
      case 0:
        rotation = 3;
        break;
      case 1:
        rotation = 0;
        break;
      case 2:
        rotation = 1;
        break;
      case 3:
        rotation = 2;
        break;
    }
  } else {
    rotation = (rotation + 1) % 4;
  }
}

bool fruitCollision() {
  bool returnBool = false;
  if (xPos[active] >= fruitX - 1 && xPos[active] <= fruitX + 2 && yPos[active] >= fruitY && yPos[active] <= fruitY + 2)
  {
    returnBool = true;
  }
  return returnBool;
}

void drawFruit() {
  for (byte i = 0; i < 3; i++)
  {
    for (byte j = 0; j < 3; j++)
    {
      oled.drawPixel(fruitX - i + 1, fruitY - j + 1);
    }
  }
}

void spawnFruit() {
  fruitX = random(1, 126);
  fruitY = random(1, 62);
}

void snakeGame() {
  snakeDraw();
  drawFruit();
  if (frameNow + 30 < millis() % 65535 )
  {
    frameNow = millis() % 65535;
    activeNext();
    byte index = (active + maxLength - 1) % maxLength;
    switch (rotation)
    {
      case 0:
        yPos[active] = yPos[index] - 1;
        xPos[active] = xPos[index];
        break;
      case 1:
        xPos[active] = xPos[index] + 1;
        yPos[active] = yPos[index];
        break;
      case 2:
        yPos[active] = yPos[index] + 1;
        xPos[active] = xPos[index];
        break;
      case 3:
        xPos[active] = xPos[index] - 1;
        yPos[active] = yPos[index];
        break;
    }
    if (collision())
    {
      score = 0;
    } else if (fruitCollision())
    {
      score++;
      spawnFruit();
    }
  }
}

void draw(void) {
  if (startUp)
  {
    startUpImage();
  } else if (playSnake)
  {
    snakeGame();
    displayScore();
  } else
  {
    updateTimeTempDisp();
  }
}

void displayScore() {
  char temp[8];
  itoa(score, temp, 10);
  oled.setFont(u8g_font_helvR12);
  oled.drawStr(0, 12, temp);
}




